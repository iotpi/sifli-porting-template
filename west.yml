## west.yml
```yaml
manifest:
  version: "1.2"
  remotes:
    - name: zephyrproject-rtos
      url-base: https://github.com/zephyrproject-rtos

  defaults:
    remote: zephyrproject-rtos

  projects:
    - name: zephyr
      revision: v4.3.0
      import:
        name-allowlist:
          - cmsis_6
          - cmsis-dsp
          - cmsis-nn
          - picolibc
          - hal_sifli
  self:
    path: .
```
